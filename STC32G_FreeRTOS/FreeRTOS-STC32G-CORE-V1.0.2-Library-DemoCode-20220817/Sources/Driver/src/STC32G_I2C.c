/*---------------------------------------------------------------------*/
/* --- STC MCU Limited ------------------------------------------------*/
/* --- STC 1T Series MCU Demo Programme -------------------------------*/
/* --- Mobile: (86)13922805190 ----------------------------------------*/
/* --- Fax: 86-0513-55012956,55012947,55012969 ------------------------*/
/* --- Tel: 86-0513-55012928,55012929,55012966 ------------------------*/
/* --- Web: www.STCMCU.com --------------------------------------------*/
/* --- Web: www.STCMCUDATA.com  ---------------------------------------*/
/* --- QQ:  800003751 -------------------------------------------------*/
/* ﺫﻝﺗﻳﺻ۹ﺿﻌﺏﮊﺷﮨﻅﺷﮌﺗﺽﺣﺑﺯﺑﻲﺡﻣ,ﮄﻣﺿﻌﺏﮊﺷﮨﻅﺷﻉ۱ﺣﺊﮌﺗﺽﺣﭼﺯSTCﭖﺥﻉﮌﭼﺵﺙﺍﺏﮊﺷﮨ            */
/*---------------------------------------------------------------------*/

#include	"STC32G_I2C.h"

uint8_t I2C_BUF_type I2C_Buffer[I2C_BUF_LENTH];

#define SLAW    0xA2
#define SLAR    0xA3

//========================================================================
// ﭦﺁﮌﮮ: void	I2C_Init(I2C_InitTypeDef *I2Cx)
// ﺣﻟﮌﺉ: I2Cﺏﺀﮌﺙﭨﺁﺏﮊﺷﮨ.
// ﺎﺳﮌﮮ: I2Cx: ﺛﻕﺗﺗﺎﺳﮌﮮ,ﮄﻣﺎﺳﺟﺙI2C.hﭺﺅﭖﺥﭘ۷ﺻﮒ.
// ﺓﭖﭨﻊ: none.
// ﺍﮔﺎﺝ: V1.0, 2012-11-22
//========================================================================
void	I2C_Init(I2C_InitTypeDef *I2Cx)
{
	if(I2Cx->I2C_Mode == I2C_Mode_Master)
	{
		I2C_Master();			//ﺭﻟﺳ۹ﻅﺊﭨﻲ	
		I2CMSST = 0x00;		//ﮄﮒﺏﮮI2Cﻅﺊﭨﻲﻉﺑﮊ؛ﺙﺥﺑﮔﺩﺊ
		I2C_SetSpeed(I2Cx->I2C_Speed);
		if(I2Cx->I2C_MS_WDTA == ENABLE)		I2C_WDTA_EN();	//ﮌﺗﺥﻎﻉﺿﭘﺁﺓ۱ﺯﺱ
		else									I2C_WDTA_DIS();	//ﺛﻳﻅﺗﻉﺿﭘﺁﺓ۱ﺯﺱ
	}
	else
	{
		I2C_Slave();	//ﺭﻟﺳ۹ﺑﺽﭨﻲ
		I2CSLST = 0x00;		//ﮄﮒﺏﮮI2Cﺑﺽﭨﻲﻉﺑﮊ؛ﺙﺥﺑﮔﺩﺊ
		I2C_Address(I2Cx->I2C_SL_ADR);
		if(I2Cx->I2C_SL_MA == ENABLE)		I2C_MATCH_EN();	//ﺑﺽﭨﻲﭖﻊﻅﺓﺎﺫﺛﺵﺗ۵ﺥﻎ۲؛ﻅﭨﺛﺽﮌﻎﺵﻓﺩ۴ﺧﻛﭖﻊﻅﺓ
		else									I2C_MATCH_DIS();	//ﺛﻳﻅﺗﺑﺽﭨﻲﭖﻊﻅﺓﺎﺫﺛﺵﺗ۵ﺥﻎ۲؛ﺛﺽﮌﻎﺯﻱﺽﺷﺭﻟﺎﺕﭖﻊﻅﺓ
	}
	
	I2C_Function(I2Cx->I2C_Enable);
}

//========================================================================
// ﭦﺁﮌﮮ: uint8_t	Get_MSBusy_Status (void)
// ﺣﻟﮌﺉ: ﭨﮦﺫ۰ﻅﺊﭨﻲﺣ۵ﺡﭖﻉﺑﮊ؛.
// ﺎﺳﮌﮮ: none.
// ﺓﭖﭨﻊ: ﻅﺊﭨﻲﺣ۵ﺡﭖﻉﺑﮊ؛.
// ﺍﮔﺎﺝ: V1.0, 2012-11-22
//========================================================================
uint8_t Get_MSBusy_Status(void)
{
	return (I2CMSST & 0x80);
}

//========================================================================
// ﭦﺁﮌﮮ: void	Wait (void)
// ﺣﻟﮌﺉ: ﭖﺫﺑﮮﻅﺊﭨﻲﺥ۲ﮌﺛI2CﺟﻊﻅﺩﺩﺊﻅﺑﺷﺷﺱﻡﺏﺭI2CMSCR.
// ﺎﺳﮌﮮ: none.
// ﺓﭖﭨﻊ: none.
// ﺍﮔﺎﺝ: V1.0, 2012-11-22
//========================================================================
void Wait()
{
	while (!(I2CMSST & 0x40));
	I2CMSST &= ~0x40;
}

//========================================================================
// ﭦﺁﮌﮮ: void Start (void)
// ﺣﻟﮌﺉ: I2Cﻉﻎﺵﻑﺩﻭﮌﺙﭦﺁﮌﮮ.
// ﺎﺳﮌﮮ: none.
// ﺓﭖﭨﻊ: none.
// ﺍﮔﺎﺝ: V1.0, 2020-09-15
//========================================================================
void Start()
{
	I2CMSCR = 0x01;                         //ﺓ۱ﺯﺱSTARTﺣﮰﭼﻧ
	Wait();
}

//========================================================================
// ﭦﺁﮌﮮ: void SendData (char dat)
// ﺣﻟﮌﺉ: I2Cﺓ۱ﺯﺱﺻﭨﺕﺉﻉﻅﺛﻌﮌﮮﺝﻏﭦﺁﮌﮮ.
// ﺎﺳﮌﮮ: ﺓ۱ﺯﺱﭖﺥﮌﮮﺝﻏ.
// ﺓﭖﭨﻊ: none.
// ﺍﮔﺎﺝ: V1.0, 2020-09-15
//========================================================================
void SendData(char dat)
{
	I2CTXD = dat;                           //ﺷﺑﮌﮮﺝﻏﭖﺛﮌﮮﺝﻏﭨﭦﺏﮒﮄﺋ
	I2CMSCR = 0x02;                         //ﺓ۱ﺯﺱSENDﺣﮰﭼﻧ
	Wait();
}

//========================================================================
// ﭦﺁﮌﮮ: void RecvACK (void)
// ﺣﻟﮌﺉ: I2Cﭨﮦﺫ۰ACKﭦﺁﮌﮮ.
// ﺎﺳﮌﮮ: none.
// ﺓﭖﭨﻊ: none.
// ﺍﮔﺎﺝ: V1.0, 2020-09-15
//========================================================================
void RecvACK()
{
	I2CMSCR = 0x03;                         //ﺓ۱ﺯﺱﭘﭼACKﺣﮰﭼﻧ
	Wait();
}

//========================================================================
// ﭦﺁﮌﮮ: char RecvData (void)
// ﺣﻟﮌﺉ: I2Cﭘﭼﺫ۰ﺻﭨﺕﺉﻉﻅﺛﻌﮌﮮﺝﻏﭦﺁﮌﮮ.
// ﺎﺳﮌﮮ: none.
// ﺓﭖﭨﻊ: ﭘﭼﺫ۰ﮌﮮﺝﻏ.
// ﺍﮔﺎﺝ: V1.0, 2020-09-15
//========================================================================
char RecvData()
{
	I2CMSCR = 0x04;                         //ﺓ۱ﺯﺱRECVﺣﮰﭼﻧ
	Wait();
	return I2CRXD;
}

//========================================================================
// ﭦﺁﮌﮮ: void SendACK (void)
// ﺣﻟﮌﺉ: I2Cﺓ۱ﺯﺱACKﭦﺁﮌﮮ.
// ﺎﺳﮌﮮ: none.
// ﺓﭖﭨﻊ: none.
// ﺍﮔﺎﺝ: V1.0, 2020-09-15
//========================================================================
void SendACK()
{
	I2CMSST = 0x00;                         //ﺭﻟﻅﺣACKﺷﺧﭦﺧ
	I2CMSCR = 0x05;                         //ﺓ۱ﺯﺱACKﺣﮰﭼﻧ
	Wait();
}

//========================================================================
// ﭦﺁﮌﮮ: void SendNAK (void)
// ﺣﻟﮌﺉ: I2Cﺓ۱ﺯﺱNAKﭦﺁﮌﮮ.
// ﺎﺳﮌﮮ: none.
// ﺓﭖﭨﻊ: none.
// ﺍﮔﺎﺝ: V1.0, 2020-09-15
//========================================================================
void SendNAK()
{
	I2CMSST = 0x01;                         //ﺭﻟﻅﺣNAKﺷﺧﭦﺧ
	I2CMSCR = 0x05;                         //ﺓ۱ﺯﺱACKﺣﮰﭼﻧ
	Wait();
}

//========================================================================
// ﭦﺁﮌﮮ: void Stop (void)
// ﺣﻟﮌﺉ: I2Cﻉﻎﺵﻑﺱ۲ﻅﺗﭦﺁﮌﮮ.
// ﺎﺳﮌﮮ: none.
// ﺓﭖﭨﻊ: none.
// ﺍﮔﺎﺝ: V1.0, 2020-09-15
//========================================================================
void Stop()
{
	I2CMSCR = 0x06;                         //ﺓ۱ﺯﺱSTOPﺣﮰﭼﻧ
	Wait();
}

//========================================================================
// ﭦﺁﮌﮮ: void SendCmdData (uint8_t cmd, uint8_t dat)
// ﺣﻟﮌﺉ: I2Cﺓ۱ﺯﺱﺻﭨﺕﺉﻉﻅﺛﻌﮌﮮﺝﻏﭦﺁﮌﮮ.
// ﺎﺳﮌﮮ: ﺣﮰﭼﻧ/ﮌﮮﺝﻏ.
// ﺓﭖﭨﻊ: none.
// ﺍﮔﺎﺝ: V1.0, 2020-09-15
//========================================================================
void SendCmdData(uint8_t cmd, uint8_t dat)
{
	I2CTXD = dat;                           //ﺷﺑﮌﮮﺝﻏﭖﺛﮌﮮﺝﻏﭨﭦﺏﮒﮄﺋ
	I2CMSCR = cmd;                          //ﺭﻟﻅﺣﺣﮰﭼﻧ
	Wait();
}

//========================================================================
// ﭦﺁﮌﮮ: void	I2C_WriteNbyte(uint8_t addr, uint8_t *p, uint8_t number)
// ﺣﻟﮌﺉ: I2Cﺷﺑﺫﻣﮌﮮﺝﻏﭦﺁﮌﮮ.
// ﺎﺳﮌﮮ: addr: ﻅﺕﭘ۷ﭖﻊﻅﺓ, *pﺷﺑﺫﻣﮌﮮﺝﻏﺑﮔﺑ۱ﺳﭨﻅﺣ, numberﺷﺑﺫﻣﮌﮮﺝﻏﺕﺉﮌﮮ.
// ﺓﭖﭨﻊ: none.
// ﺍﮔﺎﺝ: V1.0, 2020-09-15
//========================================================================
void I2C_WriteNbyte(uint8_t addr, uint8_t *p, uint8_t number)  /*  WordAddress,First Data Address,Byte lenth   */
{
	Start();                                //ﺓ۱ﺯﺱﺩﻭﮌﺙﺣﮰﭼﻧ
	SendData(SLAW);                         //ﺓ۱ﺯﺱﺭﻟﺎﺕﭖﻊﻅﺓ+ﺷﺑﺣﮰﭼﻧ
	RecvACK();
	SendData(addr);                         //ﺓ۱ﺯﺱﺑﮔﺑ۱ﭖﻊﻅﺓ
	RecvACK();
	do
	{
		SendData(*p++);
		RecvACK();
	}
	while(--number);
	Stop();                                 //ﺓ۱ﺯﺱﺱ۲ﻅﺗﺣﮰﭼﻧ
}

//========================================================================
// ﭦﺁﮌﮮ: void	I2C_ReadNbyte(uint8_t addr, uint8_t *p, uint8_t number)
// ﺣﻟﮌﺉ: I2Cﭘﭼﺫ۰ﮌﮮﺝﻏﭦﺁﮌﮮ.
// ﺎﺳﮌﮮ: addr: ﻅﺕﭘ۷ﭖﻊﻅﺓ, *pﭘﭼﺫ۰ﮌﮮﺝﻏﺑﮔﺑ۱ﺳﭨﻅﺣ, numberﭘﭼﺫ۰ﮌﮮﺝﻏﺕﺉﮌﮮ.
// ﺓﭖﭨﻊ: none.
// ﺍﮔﺎﺝ: V1.0, 2020-09-15
//========================================================================
void I2C_ReadNbyte(uint8_t addr, uint8_t *p, uint8_t number)   /*  WordAddress,First Data Address,Byte lenth   */
{
	Start();                                //ﺓ۱ﺯﺱﺩﻭﮌﺙﺣﮰﭼﻧ
	SendData(SLAW);                         //ﺓ۱ﺯﺱﺭﻟﺎﺕﭖﻊﻅﺓ+ﺷﺑﺣﮰﭼﻧ
	RecvACK();
	SendData(addr);                         //ﺓ۱ﺯﺱﺑﮔﺑ۱ﭖﻊﻅﺓ
	RecvACK();
	Start();                                //ﺓ۱ﺯﺱﺩﻭﮌﺙﺣﮰﭼﻧ
	SendData(SLAR);                         //ﺓ۱ﺯﺱﺭﻟﺎﺕﭖﻊﻅﺓ+ﭘﭼﺣﮰﭼﻧ
	RecvACK();
	do
	{
		*p = RecvData();
		p++;
		if(number != 1) SendACK();          //send ACK
	}
	while(--number);
	SendNAK();                              //send no ACK	
	Stop();                                 //ﺓ۱ﺯﺱﺱ۲ﻅﺗﺣﮰﭼﻧ
}
