/*---------------------------------------------------------------------*/
/* --- STC MCU Limited ------------------------------------------------*/
/* --- STC 1T Series MCU Demo Programme -------------------------------*/
/* --- Mobile: (86)13922805190 ----------------------------------------*/
/* --- Fax: 86-0513-55012956,55012947,55012969 ------------------------*/
/* --- Tel: 86-0513-55012928,55012929,55012966 ------------------------*/
/* --- Web: www.STCMCU.com --------------------------------------------*/
/* --- Web: www.STCMCUDATA.com  ---------------------------------------*/
/* --- QQ:  800003751 -------------------------------------------------*/
/* ﺫﻝﺗﻳﺻ۹ﺿﻌﺏﮊﺷﮨﻅﺷﮌﺗﺽﺣﺑﺯﺑﻲﺡﻣ,ﮄﻣﺿﻌﺏﮊﺷﮨﻅﺷﻉ۱ﺣﺊﮌﺗﺽﺣﭼﺯSTCﭖﺥﻉﮌﭼﺵﺙﺍﺏﮊﺷﮨ            */
/*---------------------------------------------------------------------*/

#include	"STC32G_I2C.h"

//========================================================================
//                               ﺎﺝﭖﻊﺎﻛﭼﺟﺭﻱﺣﺊ
//========================================================================

I2C_IsrTypeDef I2CIsr;
bit I2C_DisplayFlag;

//========================================================================
//                            ﺱﻗﺎﺟﭦﺁﮌﮮﭦﺱﺎﻛﭼﺟﺭﻱﺣﺊ
//========================================================================


//========================================================================
// ﭦﺁﮌﮮ: I2C_ISR_Handler
// ﺣﻟﮌﺉ: I2Cﻅﺷﭘﺵﭦﺁﮌﮮ.
// ﺎﺳﮌﮮ: none.
// ﺓﭖﭨﻊ: none.
// ﺍﮔﺎﺝ: V1.0, 2020-09-23
//========================================================================
void I2C_ISR_Handler() interrupt I2C_VECTOR
{
	// TODO: ﺿﻌﺑﺯﺑ۵ﮊﻥﺙﺽﺽﺣﭨ۶ﺑﻲﺡﻣ

	// ﻅﺊﭨﻲﺥ۲ﮌﺛ
	I2CMSST &= ~0x40;       //I2Cﻅﺕﭼﻧﺓ۱ﺯﺱﺱﻡﺏﺭﻉﺑﮊ؛ﮄﮒﺏﮮ

	if(DMA_I2C_CR & 0x04)   //ACKERR
	{
		DMA_I2C_CR &= ~0x04;  //ﺓ۱ﮌﮮﺝﻏﭦﮩﮌﻁﭖﺛNAK
	}

	// ﺑﺽﭨﻲﺥ۲ﮌﺛ
	if (I2CSLST & 0x40)
	{
		I2CSLST &= ~0x40;                       //ﺑ۵ﭺﻥSTARTﮌﺡﺙﹼ
	}
	else if (I2CSLST & 0x20)
	{
		I2CSLST &= ~0x20;                       //ﺑ۵ﭺﻥRECVﮌﺡﺙﹼ۲؛SLACKOﺭﻟﻅﺣﺳ۹0
		if (I2CIsr.isda)
		{
			I2CIsr.isda = 0;                           //ﺑ۵ﭺﻥRECVﮌﺡﺙﹼ۲۷RECV DEVICE ADDR۲۸
		}
		else if (I2CIsr.isma)
		{
			I2CIsr.isma = 0;                           //ﺑ۵ﭺﻥRECVﮌﺡﺙﹼ۲۷RECV MEMORY ADDR۲۸
			I2CIsr.addr = I2CRXD;
			I2CTXD = I2C_Buffer[I2CIsr.addr];
		}
		else
		{
			I2C_Buffer[I2CIsr.addr++] = I2CRXD;            //ﺑ۵ﭺﻥRECVﮌﺡﺙﹼ۲۷RECV DATA۲۸
		}
	}
	else if (I2CSLST & 0x10)
	{
		I2CSLST &= ~0x10;                       //ﺑ۵ﭺﻥSENDﮌﺡﺙﹼ
		if (I2CSLST & 0x02)
		{
			I2CTXD = 0xff;
		}
		else
		{
			I2CTXD = I2C_Buffer[++I2CIsr.addr];
		}
	}
	else if (I2CSLST & 0x08)
	{
		I2CSLST &= ~0x08;                       //ﺑ۵ﭺﻥSTOPﮌﺡﺙﹼ
		I2CIsr.isda = 1;
		I2CIsr.isma = 1;
		I2C_DisplayFlag = 1;
	}
}

