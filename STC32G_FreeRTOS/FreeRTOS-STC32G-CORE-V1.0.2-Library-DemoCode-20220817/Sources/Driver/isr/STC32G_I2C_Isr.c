/*---------------------------------------------------------------------*/
/* --- STC MCU Limited ------------------------------------------------*/
/* --- STC 1T Series MCU Demo Programme -------------------------------*/
/* --- Mobile: (86)13922805190 ----------------------------------------*/
/* --- Fax: 86-0513-55012956,55012947,55012969 ------------------------*/
/* --- Tel: 86-0513-55012928,55012929,55012966 ------------------------*/
/* --- Web: www.STCMCU.com --------------------------------------------*/
/* --- Web: www.STCMCUDATA.com  ---------------------------------------*/
/* --- QQ:  800003751 -------------------------------------------------*/
/* 如果您在使用过程中有什么问题或建议,欢迎随时与STC公司联系            */
/*---------------------------------------------------------------------*/

#include	"STC32G_I2C.h"

//========================================================================
//                               全局变量定义
//========================================================================

I2C_IsrTypeDef I2CIsr;
bit I2C_DisplayFlag;

//========================================================================
//                            函数声明和全局变量定义
//========================================================================


//========================================================================
// 函数: I2C_ISR_Handler
// 描述: I2C中断服务函数.
// 参数: none.
// 返回: none.
// 版本: V1.0, 2020-09-23
//========================================================================
void I2C_ISR_Handler() interrupt I2C_VECTOR
{
	// TODO: 在此处添加用户代码

	// 清中断标志
	I2CMSST &= ~0x40;       //I2C主模式状态寄存器清除标志

	if(DMA_I2C_CR & 0x04)   //ACKERR
	{
		DMA_I2C_CR &= ~0x04;  //清除ACK错误标志
	}

	// 从模式中断处理
	if (I2CSLST & 0x40)
	{
		I2CSLST &= ~0x40;                       //清除START中断标志
	}
	else if (I2CSLST & 0x20)
	{
		I2CSLST &= ~0x20;                       //清除RECV中断标志
		if (I2CIsr.isda)
		{
			I2CIsr.isda = 0;                           //清除RECV中断标志，接收设备地址
		}
		else if (I2CIsr.isma)
		{
			I2CIsr.isma = 0;                           //清除RECV中断标志，接收内存地址
			I2CIsr.addr = I2CRXD;
			I2CTXD = I2C_Buffer[I2CIsr.addr];
		}
		else
		{
			I2C_Buffer[I2CIsr.addr++] = I2CRXD;            //清除RECV中断标志，接收数据
		}
	}
	else if (I2CSLST & 0x10)
	{
		I2CSLST &= ~0x10;                       //清除SEND中断标志
		if (I2CSLST & 0x02)
		{
			I2CTXD = 0xff;
		}
		else
		{
			I2CTXD = I2C_Buffer[++I2CIsr.addr];
		}
	}
	else if (I2CSLST & 0x08)
	{
		I2CSLST &= ~0x08;                       //清除STOP中断标志
		I2CIsr.isda = 1;
		I2CIsr.isma = 1;
		I2C_DisplayFlag = 1;
	}
}

